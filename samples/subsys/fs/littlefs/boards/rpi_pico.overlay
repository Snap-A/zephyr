
/delete-node/ &code_partition;

&flash0 {
    partitions {
        compatible = "fixed-partitions";
        #address-cells = <1>;
        #size-cells = <1>;

        code_partition: partition@100 {
            label = "code-partition";
            reg = <0x100 (DT_SIZE_M(2)-0x100-DT_SIZE_K(64))>;
            read-only;
        };

        storage_partition: storage_partition@1f0000 {
            label = "storage-partition";
            reg = <(DT_SIZE_M(2)-DT_SIZE_K(64)) (DT_SIZE_K(64))>;
        };
    };
};
