## drivers/adc/Kconfig.txxNSxx1
```kconfig
# TI ADCxxxNSxx1 ADC configuration options

# Copyright (c) 2025 Andreas Wolf
# SPDX-License-Identifier: Apache-2.0

config ADC_TXXNSXX1
	bool "TI ADCxxNSxx1 driver"
	default y
	select SPI
	help
	  Enable TI ADCxxNSxx1 ADC driver.

	  The TI ADCxx/1/2/4/Sxx1 are 1/2/4 channel 8- to 12-bit A/D converters
	  with SPI interface.
```

## drivers/gpio/Kconfig.sn74lvc1g373
```kconfig
# Copyright (c) 2025 Andreas Wolf <awolf002@gmail.com>
# SPDX-License-Identifier: Apache-2.0

config GPIO_SN74LVC1G373
	bool "SN74LVC1G373 single D-Type latch as GPIO output"
	default y
	depends on DT_HAS_TI_SN74LVC1G373_ENABLED
	depends on SPI
	help
	  Use SN74LVC1G373 as single-channel GPIO output via SPI ('CS' = 'LE', 'CODI' = 'D')

if GPIO_SN74LVC1G373

config GPIO_SN74LVC1G373_INIT_PRIORITY
	int "Init priority"
	default 71
	help
	  Device driver initialization priority.

endif
```

## dts/bindings/adc/ti,adcxx2s021.yaml
```yaml
description: Texas Instrument ADCxx2S021

compatible: "ti,adcxx2s021"

include: ti,adcxxNsxx1-base.yaml
```

## dts/bindings/adc/ti,adcxx2s051.yaml
```yaml
description: Texas Instrument ADCxx2S051

compatible: "ti,adcxx2s051"

include: ti,adcxxNsxx1-base.yaml
```

## dts/bindings/adc/ti,adcxx2s101.yaml
```yaml
description: Texas Instrument ADCxx2S101

compatible: "ti,adcxx2s101"

include: ti,adcxxNsxx1-base.yaml
```

## dts/bindings/adc/ti,adcxx2sxx1.yaml
```yaml
description: Texas Instrument ADCxx2Sxx1

compatible: "ti,adcxx2sxx1"

include: ti,adcxxNsxx1-base.yaml
```

## dts/bindings/adc/ti,adcxxNsxx1-base.yaml
```yaml
# Common fields for Texas Instrument ADCxx1Sxx1/ADCxx2Sxx1/ADCxx4Sxx1

include: [adc-controller.yaml, spi-device.yaml]

properties:
  "#io-channel-cells":
    const: 1

io-channel-cells:
  - input
```

## dts/bindings/dac/ti,dacx311-base.yaml
```yaml
# Copyright (c) 2025 Andreas Wolf <awolf002@gmail.com>
# SPDX-License-Identifier: Apache-2.0

include: [dac-controller.yaml, spi-device.yaml]

description: Texas Instrument 8-Bit to 14-Bit DAC <N>311

# properties:
#  voltage-reference:
#    type: int
#    required: true
#    description: |
#      DAC voltage reference select

properties:
  "#io-channel-cells":
    const: 1

io-channel-cells:
  - output
```

## dts/bindings/gpio/infineon,airoc-gpio.yaml
```yaml
description: INFINEON AIROC GPIO PORT node

compatible: "infineon,airoc-gpio"

include: [gpio-controller.yaml, base.yaml]

properties:
  reg:
    required: false

  "#gpio-cells":
    const: 2

gpio-cells:
  - pin
  - flags
```

## dts/bindings/gpio/ti,sn74lvc1g373.yaml
```yaml
# Copyright (c) 2025 Andreas Wolf <awolf002@gmail.com>
# SPDX-License-Identifier: Apache-2.0

description: SN74LCV1G373 SPI based GPIO expander

compatible: "ti,sn74lvc1g373"

include: [gpio-controller.yaml, spi-device.yaml]

properties:
  ngpios:
    type: int
    required: true
    const: 1
    description: Number of supported gpios

  "#gpio-cells":
    const: 2

gpio-cells:
  - pin
  - flags
```

## samples/basic/blinky/boards/rpi_pico_rp2040_w.conf
```kconfig
# Add Wifi Drivers to access GPIO API
CONFIG_WIFI=y
CONFIG_NETWORKING=y
CONFIG_ENTROPY_GENERATOR=y
CONFIG_TEST_RANDOM_GENERATOR=y
```
